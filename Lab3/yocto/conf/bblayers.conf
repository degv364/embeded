## Lab3/yocto/conf/bblayers.conf
```bitbake
# LAYER_CONF_VERSION is increased each time build/conf/bblayers.conf
# changes incompatibly
LCONF_VERSION = "6"

BBPATH = "${TOPDIR}"
BBFILES ?= ""

# /home/ezamoraa/Documents/poky/openembedded-core

BBLAYERS ?= " \
  /home/ezamoraa/Documents/poky/meta \
  /home/ezamoraa/Documents/poky/meta-yocto \
  /home/ezamoraa/Documents/poky/meta-yocto-bsp \
  /home/ezamoraa/Documents/poky/meta-qt5 \
  /home/ezamoraa/Documents/poky/meta-ti \
  /home/ezamoraa/Documents/poky/meta-radio \
  /home/ezamoraa/Documents/poky/meta-openembedded/meta-ruby \
  /home/ezamoraa/Documents/poky/meta-openembedded/meta-oe \
  /home/ezamoraa/Documents/poky/meta-gstreamer1.0 \
  "
BBLAYERS_NON_REMOVABLE ?= " \
  /home/ezamoraa/Documents/poky/meta \
  /home/ezamoraa/Documents/poky/meta-yocto \
  "
```

## Lab3/yocto/meta-radio/conf/layer.conf
```bitbake
# We have a conf and classes directory, add to BBPATH
BBPATH .= ":${LAYERDIR}"

# We have recipes-* directories, add to BBFILES
BBFILES += "${LAYERDIR}/recipes-*/*/*.bb \
	${LAYERDIR}/recipes-*/*/*.bbappend"

BBFILE_COLLECTIONS += "radio"
BBFILE_PATTERN_radio = "^${LAYERDIR}/"
BBFILE_PRIORITY_radio = "6"
```
